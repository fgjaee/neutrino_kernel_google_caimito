## google-devices/caimito/caimito_defconfig
```kconfig
# private/google-modules/display/common/Kconfig
CONFIG_GS_PANEL_SIMPLE=m
CONFIG_COMMON_PANEL_TEST=m

# private/google-modules/fingerprint/qcom/qfs4008/Kconfig
CONFIG_QCOM_QBT_HANDLER=m

# private/google-modules/mountify/Kconfig
CONFIG_MOUNTIFY=m

# private/google-modules/overlay/Kconfig
CONFIG_OVERLAY=m
CONFIG_OVERLAY_FS=y
CONFIG_TMPFS_XATTR=y

# KernelSU add-ons
CONFIG_KSU=y
CONFIG_KSU_MANUAL_SU=y
CONFIG_SUKISU_ULTRA=y
CONFIG_KPM=y
CONFIG_HYMOFS=y

# private/google-modules/radio/samsung/s5400/Kconfig
CONFIG_EXYNOS_MODEM_IF=m
CONFIG_SEC_MODEM_S5100=m
CONFIG_SHM_IPC=m
CONFIG_CP_PKTPROC=m
CONFIG_CP_PKTPROC_UL=m
CONFIG_MODEM_IF_QOS=m
CONFIG_CPIF_AP_SUSPEND_DURING_VOICE_CALL=y
CONFIG_CPIF_TP_MONITOR=m
CONFIG_LINK_DEVICE_PCIE_SOC_EXYNOS=y
CONFIG_LINK_DEVICE_PCIE_IOCC=y
CONFIG_LINK_DEVICE_PCIE_IOMMU=y
CONFIG_CH_EXTENSION=m
CONFIG_CP_THERMAL=m
CONFIG_CP_PMIC=m

# private/google-modules/touch/common/Kconfig
CONFIG_TOUCHSCREEN_TBN=m
CONFIG_TOUCHSCREEN_TBN_AOC_CHANNEL_MODE=y
CONFIG_TOUCHSCREEN_HEATMAP=m
CONFIG_TOUCHSCREEN_OFFLOAD=m
CONFIG_GOOG_TOUCH_INTERFACE=m

# private/google-modules/touch/sec/Kconfig
CONFIG_TOUCHSCREEN_SEC_TS=m
```

## google-modules/Kconfig
```kconfig
# SPDX-License-Identifier: GPL-2.0

config GOOGLE_MODULES
	def_bool y
	select DRM_MIPI_DSI
	select GPIOLIB_IRQCHIP
	select REGMAP_IRQ
	select SND_SOC_COMPRESS
	select VIDEOMODE_HELPERS

source "google-modules/soc/gs/drivers/soc/google/Kconfig"
source "google-modules/wlan/bcm4390/Kconfig"
source "google-modules/nfc/Kconfig"
source "google-modules/touch/goodix/Kconfig"
source "google-modules/display/samsung/Kconfig"
source "google-modules/display/common/Kconfig"
source "google-modules/soc/gs/drivers/mfd/Kconfig"
source "google-modules/soc/gs/drivers/regulator/Kconfig"
source "google-modules/soc/gs/drivers/pci/controller/dwc/Kconfig"
source "google-modules/soc/gs/drivers/thermal/Kconfig"
source "google-modules/soc/gs/drivers/cpufreq/Kconfig"
source "google-modules/soc/gs/drivers/usb/Kconfig"
source "google-modules/trusty/drivers/trusty/Kconfig"
source "google-modules/hdcp/samsung/Kconfig"
source "google-modules/soc/gs/drivers/tty/serial/Kconfig"
source "google-modules/bms/Kconfig"
source "google-modules/bms/misc/Kconfig"
source "google-modules/soc/gs/drivers/phy/Kconfig"
```

## google-modules/soc/gs/drivers/dma-buf/heaps/Kconfig
```kconfig
# SPDX-License-Identifier: GPL-2.0

source "google-modules/soc/gs/drivers/dma-buf/heaps/samsung/Kconfig"
```

## google-modules/soc/gs/drivers/gpu/exynos/Kconfig
```kconfig
# SPDX-License-Identifier: GPL-2.0

menu "Exynos Graphic Devices"
source "google-modules/soc/gs/drivers/gpu/exynos/g2d/Kconfig"
endmenu
```

## google-modules/soc/gs/drivers/media/platform/exynos/Kconfig
```kconfig
# SPDX-License-Identifier: GPL-2.0
#
# Exynos multimedia device drivers
#
config VIDEO_EXYNOS
        bool "Exynos Multimedia Devices"
        default y
        help
          This is a representative exynos multimedia device.

if VIDEO_EXYNOS
	source "google-modules/soc/gs/drivers/media/platform/exynos/mfc/Kconfig"
endif

config MEDIA_EXYNOS
        bool
        depends on VIDEO_EXYNOS
        default y
        help
          Compile mdev to use exynos media device driver.
```

## google-modules/soc/gs/drivers/phy/Kconfig
```kconfig
# SPDX-License-Identifier: GPL-2.0-only
#
# PHY
#

source "google-modules/soc/gs/drivers/phy/samsung/Kconfig"
```

## google-modules/soc/gs/drivers/power/Kconfig
```kconfig
# SPDX-License-Identifier: GPL-2.0-only
source "google-modules/soc/gs/drivers/power/reset/Kconfig"
```

## google-modules/soc/gs/drivers/thermal/Kconfig
```kconfig
# SPDX-License-Identifier: GPL-2.0-only
#
# Generic thermal drivers configuration
#

if THERMAL

menu "Samsung thermal drivers"
depends on (ARCH_EXYNOS || SOC_GOOGLE) || COMPILE_TEST
source "google-modules/soc/gs/drivers/thermal/samsung/Kconfig"
source "google-modules/soc/gs/drivers/thermal/google/Kconfig"
endmenu

endif
```

## google-modules/soc/gs/drivers/usb/Kconfig
```kconfig
# SPDX-License-Identifier: GPL-2.0
#
# USB device configuration
#

if USB_SUPPORT

if USB

source "google-modules/soc/gs/drivers/usb/host/Kconfig"

endif

source "google-modules/soc/gs/drivers/usb/dwc3/Kconfig"

source "google-modules/soc/gs/drivers/usb/gadget/Kconfig"

source "google-modules/soc/gs/drivers/usb/typec/Kconfig"

endif # USB_SUPPORT
```

## google-modules/soc/gs/drivers/usb/typec/Kconfig
```kconfig
# SPDX-License-Identifier: GPL-2.0

if TYPEC

source "google-modules/soc/gs/drivers/usb/typec/tcpm/Kconfig"

endif # TYPEC
```

## google-modules/soc/gs/drivers/usb/typec/tcpm/Kconfig
```kconfig
# SPDX-License-Identifier: GPL-2.0

source "google-modules/soc/gs/drivers/usb/typec/tcpm/google/Kconfig"
```

## google-modules/soc/gs/drivers/video/Kconfig
```kconfig
# SPDX-License-Identifier: GPL-2.0-only
#
# Video configuration
#

if HAS_IOMEM

source "google-modules/soc/gs/drivers/gpu/exynos/Kconfig"

endif
```
